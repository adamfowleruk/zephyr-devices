## boards/arm/nrf52833_herald_base/nrf52833_herald_base_defconfig
```kconfig
# SPDX-License-Identifier: Apache-2.0

CONFIG_SOC_SERIES_NRF52X=y
CONFIG_SOC_NRF52833_QIAA=y
CONFIG_BOARD_NRF52833_HERALD_BASE=y

# DO NOT EVER CHANGE THE BELOW! IT COULD BRICK THE DEVICE!!!
# This pin (p0.18/reset) is used for ACC_INT1 (Accelerometer GPIO Interrupt 1) on the main board
CONFIG_GPIO_AS_PINRESET=n

# Enable MPU (Memory protection unit)
CONFIG_ARM_MPU=y

# Enable SPI for external flash
CONFIG_SPI=y

# Standard LIS2DE12 settings
CONFIG_I2C=y
CONFIG_SENSOR=y
CONFIG_LIS2DH=y
CONFIG_LIS2DH_OPER_MODE_LOW_POWER=y
CONFIG_LIS2DH_ODR_9_LOW=y
```

## drivers/sensor/tmp1075/Kconfig
```kconfig
# TMP1075 digital temperature sensor config options

# Copyright (c) 2021 Herald Project Contributors
# Copyright (c) 2016 Intel Corporation
# SPDX-License-Identifier: Apache-2.0

menuconfig TMP1075
	bool "TMP1075 Digital temperature sensor"
	depends on I2C
	help
	  Enable driver for TMP1075 Digital temperature sensors.
```
